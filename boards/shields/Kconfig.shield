## boards/shields/Kconfig.shield
```kconfig
# Copyright (c) 2020 Pete Johanson
# SPDX-License-Identifier: MIT

config SHIELD_CORNE_LEFT_W
    def_bool $(shields_list_contains,corne_left_w)

config SHIELD_CORNE_RIGHT_W
    def_bool $(shields_list_contains,corne_right_w)
```

## boards/shields/cornew/Kconfig.shield
```kconfig
# Copyright (c) 2020 Pete Johanson
# SPDX-License-Identifier: MIT

config SHIELD_CORNEW_LEFT
    def_bool $(shields_list_contains,cornew_left)

config SHIELD_CORNEW_RIGHT
    def_bool $(shields_list_contains,cornew_right)
```

## config/boards/shields/corne/Kconfig.defconfig
```kconfig
if SHIELD_CORNE_CENTRAL_DONGLE || SHIELD_CORNE_CENTRAL_LEFT

config ZMK_KEYBOARD_NAME
    default "corne"

config ZMK_SPLIT_BLE_ROLE_CENTRAL
    default y

endif

if SHIELD_CORNE_CENTRAL_DONGLE || SHIELD_CORNE_CENTRAL_LEFT || SHIELD_CORNE_PERIPHERAL_LEFT || SHIELD_CORNE_PERIPHERAL_RIGHT

config ZMK_SPLIT
    default y

endif

config ZMK_BLE
	default y
	
if ZMK_DISPLAY

config I2C
    default y

config SSD1306
    default y

choice ZMK_DISPLAY_WORK_QUEUE
    default ZMK_DISPLAY_WORK_QUEUE_DEDICATED
endchoice

endif # ZMK_DISPLAY

if LVGL

config LV_Z_VDB_SIZE
    default 64

config LV_DPI_DEF
    default 148

config LV_Z_BITS_PER_PIXEL
    default 1

choice LV_COLOR_DEPTH
    default LV_COLOR_DEPTH_1
endchoice

endif # LVGL

if ZMK_RGB_UNDERGLOW

# This default value cuts down on tons of excess .conf files, if you're using GPIO, manually disable this
config SPI
    default n

config ZMK_RGB_UNDERGLOW_EXT_POWER
    bool "RGB underglow toggling also controls external power"
    default y

config ZMK_RGB_UNDERGLOW_BRT_MIN
    int "RGB underglow minimum brightness in percent"
    range 0 100
    default 0

config ZMK_RGB_UNDERGLOW_BRT_MAX
    int "RGB underglow maximum brightness in percent"
    range ZMK_RGB_UNDERGLOW_BRT_MIN 100
    default 100

config ZMK_RGB_UNDERGLOW_HUE_STEP
    int "RGB underglow hue step in degrees"
    range 0 359
    default 10

config ZMK_RGB_UNDERGLOW_SAT_STEP
    int "RGB underglow saturation step in percent"
    range 0 100
    default 10

config ZMK_RGB_UNDERGLOW_BRT_STEP
    int "RGB underglow brightness step in percent"
    range 0 100
    default 10

config ZMK_RGB_UNDERGLOW_HUE_START
    int "RGB underglow start hue value in degrees"
    range 0 359
    default 0

config ZMK_RGB_UNDERGLOW_SAT_START
    int "RGB underglow start saturations value in percent"
    range 0 100
    default 100

config ZMK_RGB_UNDERGLOW_BRT_START
    int "RGB underglow start brightness value in percent"
    range ZMK_RGB_UNDERGLOW_BRT_MIN ZMK_RGB_UNDERGLOW_BRT_MAX
    default ZMK_RGB_UNDERGLOW_BRT_MAX

config ZMK_RGB_UNDERGLOW_SPD_START
    int "RGB underglow start animation speed value"
    range 1 5
    default 3

config ZMK_RGB_UNDERGLOW_EFF_START
    int "RGB underglow start effect int value related to the effect enum list"
    range 0 3
    default 0

config ZMK_RGB_UNDERGLOW_ON_START
    bool "RGB underglow starts on by default"
    default y

config ZMK_RGB_UNDERGLOW_AUTO_OFF_IDLE
    bool "Turn off RGB underglow when keyboard goes into idle state"

config ZMK_RGB_UNDERGLOW_AUTO_OFF_USB
    bool "Turn off RGB underglow when USB is disconnected"
    depends on USB_DEVICE_STACK

endif #ZMK_RGB_UNDERGLOW
```

## config/west.yml
```yaml
manifest:
  remotes:
    #- name: williambonfim
    #  url-base: https://github.com/williambonfim
    - name: zmkfirmware
      url-base: https://github.com/zmkfirmware
    - name: petejohanson
      url-base: https://github.com/petejohanson
    - name: williambonfim
      url-base: https://github.com/williambonfim
    #- name: englmaxi
    #  url-base: https://github.com/englmaxi
    #- name: caksoylar
    #  url-base: https://github.com/caksoylar
    #- name: dhruvinsh
    #  url-base: https://github.com/dhruvinsh
  projects:
    #- name: zmk
    #  remote: zmkfirmware
    #  revision: main
    #  import: app/west.yml
    - name: zmk
      remote: williambonfim
      revision: main
      import: app/west.yml
    
    # Dongle display
    - name: zmk-dongle-display
      remote: williambonfim
      revision: main

    # Hammerbeam display 
    - name: zmk-hammerbeam-display
      remote: williambonfim
      revision: main
    
    # Auto Layer
    - name: zmk-auto-layer
      remote: williambonfim
      revision: main
    
    # Helper Macros
    - name: zmk-helpers
      remote: williambonfim
      revision: main

    # Mouse movement
    #- name: zmk
    #  remote: petejohanson
    #  revision: feat/pointers-move-scroll
    #  import: app/west.yml

    # modules
    #- name: zmk-rgbled-widget
    #  remote: caksoylar
    #  revision: main
    #- name: zmk-tri-state
    #  remote: dhruvinsh
    #  revision: main
    #- name: zmk-dongle-display
    #  remote: englmaxi
    #  revision: main
  self:
    path: config
```
